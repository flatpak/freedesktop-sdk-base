## meta-freedesktop/conf/distro/freedesktop.conf
```bitbake
DISTRO = "freedesktop"
DISTRO_NAME = "Freedesktop base image"
DISTRO_VERSION = "1.5"
SDK_VENDOR = "-freedesktop"
SDK_VERSION := "1.5"

MAINTAINER = "Alexander Larsson <alexl@redhat.com>"

TARGET_VENDOR = "-unknown"

LOCALCONF_VERSION = "1"

LOCALE_UTF8_ONLY = "1"
DISTRO_FEATURES = "argp largefile xattr pam ${DISTRO_FEATURES_LIBC}"

SDK_NAME = "${DISTRO}-${TCLIBC}-${SDK_ARCH}-${TARGET_ARCH}"
SDKPATH = "/opt/${DISTRO}/${SDK_VERSION}"

QEMU_TARGETS ?= "x86_64"

RDEPENDS_python3-modules_remove = "python3-2to3"

PREFERRED_PROVIDER_virtual/kernel = "linux-yocto"
PREFERRED_PROVIDER_jpeg = "libjpeg-turbo"

PREMIRRORS ?= "\
bzr://.*/.*   http://autobuilder.yoctoproject.org/sources/ \n \
cvs://.*/.*   http://autobuilder.yoctoproject.org/sources/ \n \
git://.*/.*   http://autobuilder.yoctoproject.org/sources/ \n \
hg://.*/.*    http://autobuilder.yoctoproject.org/sources/ \n \
osc://.*/.*   http://autobuilder.yoctoproject.org/sources/ \n \
p4://.*/.*    http://autobuilder.yoctoproject.org/sources/ \n \
svk://.*/.*   http://autobuilder.yoctoproject.org/sources/ \n \
svn://.*/.*   http://autobuilder.yoctoproject.org/sources/ \n"

MIRRORS =+ "\
ftp://.*/.*      http://autobuilder.yoctoproject.org/sources/ \n \
http://.*/.*     http://downloads.yoctoproject.org/mirror/sources/ \n \
https://.*/.*     http://downloads.yoctoproject.org/mirror/sources/ \n \
http://.*/.*     http://autobuilder.yoctoproject.org/sources/ \n \
https://.*/.*    http://autobuilder.yoctoproject.org/sources/ \n"

# The CONNECTIVITY_CHECK_URI's are used to test whether we can succesfully
# fetch from the network (and warn you if not). To disable the test set
# the variable to be empty.
CONNECTIVITY_CHECK_URIS = ""
```

## meta-freedesktop/conf/layer.conf
```bitbake
BBPATH := "${BBPATH}:${LAYERDIR}"

BBFILES := "${BBFILES} ${LAYERDIR}/packages/*/*.bb ${LAYERDIR}/recipes-*/*/*.bb \
	${LAYERDIR}/recipes-*/*/*.bbappend" 

BBFILE_COLLECTIONS += "freedesktop"
BBFILE_PATTERN_freedesktop := "^${LAYERDIR}/"
BBFILE_PRIORITY_freedesktop = "6"
```

## meta-freedesktop/conf/machine/qemuarmv7a.conf
```bitbake
#@TYPE: Machine
#@NAME: armv7a machine with hf, vfpv3-d16 and thumb
#@DESCRIPTION: Machine configuration to match Debian "armhf"

require conf/machine/include/arm/arch-armv7a.inc
require conf/machine/include/qemu.inc

DEFAULTTUNE = "armv7athf-vfpv3d16"

ARM_INSTRUCTION_SET = "thumb"

MACHINE_FEATURES = ""

KERNEL_IMAGETYPE = "zImage"

SERIAL_CONSOLES = "115200;ttyAMA0 115200;ttyAMA1"
```
